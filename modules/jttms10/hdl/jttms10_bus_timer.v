/* SPDX-License-Identifier: GPL-3.0-or-later */
// TI SPVU001A 11.4.2/11.4.10: two local-clock states per memory cycle,
// LRDY sampled at the end of Q1 in the second state, then once per wait
// state. The abstract target ACK supplies readiness AND data; it is not
// itself the end of the TI cycle. On-chip I/O ignores that target entirely
// (11.4.8). No LAD/control pins are generated by this transport boundary.
module jttms10_bus_timer #(
    parameter integer CLKS_PER_STATE=8
)(
    input clk, rst,
    input req, queued, blocked, io_cycle,
    input [15:0] io_rdata,
    output ack,
    output [15:0] rdata,
    output ext_req,
    input ext_ack,
    input [15:0] ext_rdata
);
    localparam integer PW=$clog2(CLKS_PER_STATE);
    localparam integer CW=$clog2(3*CLKS_PER_STATE+1);
    localparam integer PHASE_LAST_I=CLKS_PER_STATE-1;
    localparam integer CYCLE_LAST_I=2*CLKS_PER_STATE-1;
    localparam integer SAMPLE_LEFT_I=3*CLKS_PER_STATE/4;
    localparam [PW-1:0] PHASE_LAST=PHASE_LAST_I[PW-1:0];
    localparam [CW-1:0] CYCLE_LAST=CYCLE_LAST_I[CW-1:0];
    localparam [CW-1:0] SAMPLE_LEFT=SAMPLE_LEFT_I[CW-1:0];
    localparam [CW-1:0] STATE_CLKS=CLKS_PER_STATE[CW-1:0];
    reg [PW-1:0] phase, idle;
    reg [CW-1:0] left;
    reg active, served, external_done, draining, io;
    reg [15:0] data;
    // A request already queued at the preceding state boundary may absorb
    // the arbiter/cache registration clocks in that state's row phase.
    // Never backdate across an occupied/HOLD interval or a newly arriving
    // request. Late bridge dispatch can still miss Q1 and add a real wait.
    wire [PW:0] idle_available={1'b0,idle}+1'b1;
    wire credit=queued && {1'b0,phase}<=idle_available;
    wire start=req && !active && !served && !blocked && (!draining || io_cycle) &&
               (phase==0 || credit);
    wire ready=external_done || (ext_req && ext_ack);
    assign ext_req=!rst && ((start && !io_cycle) || (active && !io && !external_done));
    assign ack=active && left==0 && (io || external_done);
    assign rdata=data;

    // synthesis translate_off
    initial if(CLKS_PER_STATE<8 || CLKS_PER_STATE%4!=0)
        $fatal(1,"TI bus timing requires CLKS_PER_STATE >= 8 and divisible by four");
    // synthesis translate_on

    always @(posedge clk) begin
        if(rst) begin
            phase<=0; idle<=0; left<=0;
            active<=0; served<=0; external_done<=0; draining<=1; io<=0;
            data<=0;
        end else begin
            phase<=phase==PHASE_LAST ? {PW{1'b0}} : phase+1'b1;
            if(blocked || active || start) idle<=0;
            else if(idle!=PHASE_LAST) idle<=idle+1'b1;
            if(!req) served<=0;
            if(!ext_ack) draining<=0;
            if(start) begin
                active<=1; served<=1; io<=io_cycle;
                left<=CYCLE_LAST-{{(CW-PW){1'b0}},phase};
                external_done<=0;
                if(io_cycle) data<=io_rdata;
            end else if(active) begin
                if(left==SAMPLE_LEFT && !io && !ready)
                    left<=left+STATE_CLKS-1'b1;
                else if(left!=0) left<=left-1'b1;
                // External data is retained through completion. On-chip I/O
                // uses a Q4 read latch, consistent with the general read
                // phase; its exact internal latch edge is not specified.
                if(io && left==1) data<=io_rdata;
                if(ack) begin active<=0; external_done<=0; end
            end
            if(ext_req && ext_ack) begin
                data<=ext_rdata;
                external_done<=1;
                draining<=1;
            end
        end
    end
endmodule
