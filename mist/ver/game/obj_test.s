	ORG $8000

SCR_PALRAM	EQU $3800
OBJ_PALRAM	EQU $3840
CHR_PALRAM	EQU $38C0
HPOS_LOW	EQU $3B08
HPOS_HIGH	EQU $3B09
VPOS_LOW	EQU $3B0A
VPOS_HIGH	EQU $3B0B
OKOUT		EQU $3C00
BANK		EQU $3E00
FLIP		EQU $3D00
JOY1		EQU $3001
JOY2		EQU $3002
CRC			EQU $3005

CHR			EQU $2000
CHR_ATT		EQU $2400
SCR			EQU $2800
SCR_ATT		EQU $2C00

FLIPVAR		EQU $1010

PAL_DONE	EQU $0

RESET: 
	ORCC #$10
	LDS	#$1E00-1
	LDA #$18
	TFR A,DP
	CLRA
	STA	BANK
	LDA #0
	STA FLIP
	CLRA
	STA FLIPVAR
	CLRA
	STA HPOS_LOW
	STA HPOS_HIGH
	STA VPOS_LOW
	STA VPOS_HIGH

	LDX #$1E00
	LDA #$F8
	LDB #$F8
@L:
	STD ,X++
	CMPX #$2000
	BLT @L

;	LDX #$1E3C
;	LDY #(OBJ_SAMPLE+4)
;	LDB #4
;@L:
;	LDA ,Y+
;	STA ,X+
;	DECB
;	BNE @L
	BSR DRAW_OBJ_SAMPLE

	LBSR SETUP_PAL
FIN:
	BRA FIN

DRAW_OBJ_SAMPLE:
	;LDY #OBJ_SAMPLE
	LDY #OBJ_BRIDGE
	LDX #$1E3C
@L2:
	LDA ,Y+
	CMPA #$FA
	BEQ @LFIN
	STA ,X+
	BRA @L2
@LFIN:
	RTS

OBJ_SAMPLE2:
	FCB $1,$0,$B1,$4F
OBJ_SAMPLE:
	FCB $68,$90,$C2,$C5
	FCB $55,$04,$B1,$4F
	FCB $54,$04,$B1,$5F
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	FCB $FA

; 1E3C onwards
OBJ_LEFT: 
	FCB $7C,$70,$C2,$F0
	FCB $74,$70,$B2,$F0
	FCB $7D,$71,$C2,$00	;hover
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	FCB $FA

; 1E3C onwards
OBJ_BRIDGE:
	FCB $68,$50,$D4,$75
	FCB $69,$50,$D4,$85
	FCB $18,$00,$C4,$70
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	FCB $FA

;;;;;;;;;;;;;;;;;;;;;;;;;;;;;;;;;;;;;;;;;;;;;;;;;;;;;;;;;;;
SETUP_PAL:
	; primero la paleta
	LDA #1
	STA >PAL_DONE	; FLAG
	ANDCC #$EF
@PAL:
	LDA >PAL_DONE
	CMPA #1
	BEQ @PAL
	RTS

CHAR_PALETTE:
	; Characters. 16 palettes
	FDB $F000,$A000,$5000,$0000	; Red   tones
	FDB $0F00,$0A00,$0500,$0000	; Green tones
	FDB $00F0,$00A0,$0050,$0000	; Blue  tones
	FDB $FFF0,$AAA0,$5550,$0000	; Gray  tones

	FDB $F000,$A000,$5000,$0000	; Red   tones
	FDB $0F00,$0A00,$0500,$0000	; Green tones
	FDB $00F0,$00A0,$0050,$0000	; Blue  tones
	FDB $FFF0,$AAA0,$5550,$0000	; Gray  tones

	FDB $F000,$A000,$5000,$0000	; Red   tones
	FDB $0F00,$0A00,$0500,$0000	; Green tones
	FDB $00F0,$00A0,$0050,$0000	; Blue  tones
	FDB $FFF0,$AAA0,$5550,$0000	; Gray  tones

	FDB $F000,$A000,$5000,$0000	; Red   tones
	FDB $0F00,$0A00,$0500,$0000	; Green tones
	FDB $00F0,$00A0,$0050,$0000	; Blue  tones
	FDB $FFF0,$AAA0,$5550,$0000	; Gray  tones

; Scroll. 8 palettes
SCROLL_PALETTE:
	FDB $F000,$A000,$5000,$0000	; Red   tones
	FDB $0F00,$0A00,$0500,$0000	; Green tones
	FDB $00F0,$00A0,$0050,$0000	; Blue  tones
	FDB $FFF0,$AAA0,$5550,$0000	; Gray  tones

	FDB $F000,$A000,$5000,$0000	; Red   tones
	FDB $0F00,$0A00,$0500,$0000	; Green tones
	FDB $00F0,$00A0,$0050,$0000	; Blue  tones
	FDB $FFF0,$AAA0,$5550,$0000	; Gray  tones
OBJECT_PALETTE:
	FDB $FFF0,$AAA0,$5550,$0000	; Gray  tones
	FDB $F000,$A000,$5000,$0000	; Red   tones
	FDB $0F00,$0A00,$0500,$0000	; Green tones
	FDB $00F0,$00A0,$0050,$0000	; Blue  tones

IRQSERVICE:
	; ORCC #$10
	; fill palette
	; RG mem test
	CLRA	; Is the palette already filled?
	CMPA >PAL_DONE
	BNE @DOWORK
	CLR OKOUT
	RTI
@DOWORK:
	LDX #OBJ_PALRAM
	LDY #OBJECT_PALETTE	
@L:	LDD ,Y++
	STA ,X
	STB $100,X
	LEAX 1,X
	CMPY #(OBJECT_PALETTE+4*8)
	BNE @L

	CLR >PAL_DONE
	CLR OKOUT
	RTI

	FILL $FF,$FFF8-*

	ORG $FFF8
	.DW IRQSERVICE
	FILL $FF,$FFFE-*
	ORG $FFFE
	.DW	RESET	; Reset vector
