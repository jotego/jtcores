/*  This file is part of JTCORES. GPLv3. See jtcninja_game.v header.

    DECO 104 protection / I/O mux for Data East cninja.cpp (Joe & Mac).

    Ported from MAME deco146.cpp / deco104.cpp (deco_146_base_device +
    deco104 specialisation). For the cninja set the CPU-side address bitswap
    (cninja_protection_region_0_104_r) collapses to (real_address & 0x7ff),
    so upper_addr_bits is always 0 and every access hits the internal
    protection area (region_selects/cs routing is not needed here).

    Behaviour (see doc/deco146.cpp read_protport / write_protport):
      real_address = addr*2 & 0x7ff           (addr = word offset)
      WRITE: store din to rambank[(ra&0xff)>>1]; special ports:
             0x42 -> XOR reg, 0xee -> NAND reg, 0xa8 -> sound latch (+IRQ)
             and latch {addr,data} for immediate read-back
      READ:  if (ra==latchaddr && latchflag) return latchdata   (read-back)
             else ra ^= 0x2a4 (magic);  e = table[ra>>1];
                  src = port A/B/C or rambank[e.off>>1];
                  out = reorder(src, e.weights);
                  if e.use_xor: out^=XOR;  if e.use_nand: out&=~NAND;
                  if e.off==0x66: toggle rambank

    DECO 104 constants: magic_xor=0x2a4, bankswitch=0x66,
                        xor_port=0x42, nand_port=0xee, soundlatch_port=0xa8.

    The 1024-entry table is generated by gen_deco104_table.py into
    jtcninja_deco104_table.hex (36 bits/entry): the DECO 104 permutation is
    nibble-structured, so each entry stores 4 nibble-rotate tokens (input
    nibble p -> output nibble sel[p] rotated by rot[p], or blank) plus the
    source select / offset / xor / nand flags. See that file for the layout.
*/
module jtcninja_deco104(
    input             rst,
    input             clk,
    input             LVBL,
    input             cs,
    input      [13:1] addr,
    input      [15:0] din,
    output     [15:0] dout,
    input             rnw,
    input      [ 1:0] dsn,
    // Cabinet inputs (port A=INPUTS, B=SYSTEM, C=DSW)
    input      [`JTFRAME_BUTTONS+3:0] joystick1, joystick2,
    input      [ 3:0] cab_1p,
    input      [ 3:0] coin,
    input             service,
    input             dip_test,
    input      [15:0] dipsw,
    // Sound
    output reg [ 7:0] snd_latch,
    output reg        snd_irq
);

// ---- generated lookup table: 1024 x 36 bits in BRAM (jtframe_prom, registered
//      read -> maps to block RAM). tw is valid one clk after tidx; the 68k
//      access spans many clk so dout settles long before the CPU samples it. ----
wire [35:0] tw;

// ---- protection state ----
// rambank: 2 banks x 0x80 words ({bank,off}), in BRAM (jtframe_dual_ram). Port 0
// = CPU write, port 1 = protection read (registered -> maps to block RAM). The
// registered read adds a clk of latency, absorbed by the long 68k access.
reg         curbank;
wire [15:0] ram_q;
reg  [15:0] m_xor, m_nand;
reg  [10:0] latchaddr;
reg  [15:0] latchdata;
reg         latchflag;

// real_address = (addr*2) & 0x7ff  (bits above 10 are masked off for cninja)
wire [10:0] ra      = { addr[10:1], 1'b0 };
wire [ 7:0] ra_off  = ra[7:0];               // address & 0xff
wire [10:0] ra_xor  = ra ^ 11'h2a4;          // post magic-xor address
wire [ 9:0] tidx    = ra_xor[10:1];          // table index (>>1)

// ---- I/O ports (MAME cninja PORT_START) ----
//   INPUTS (port A): P1 low byte, P2 high byte (active low). Per MAME cninja
//     PORT_START("INPUTS"): bits0-3 joyUDLR, b4 B1, b5 B2, b6 unused,
//     b7 START1; bits8-11 joyUDLR(P2), b12 B1, b13 B2, b14 unused, b15 START2.
//   SYSTEM (port B): b0 coin1, b1 coin2, b2 service (all active low),
//                    b3 vblank (active high)
//   DSW    (port C): dip switches straight through
// jtframe joystick/coin/service are ALREADY active low (idle=1), like the
// DATA EAST ports, so they pass through directly - do NOT invert. Only the
// vblank bit is active high. START1/START2 come from cab_1p[0]/[1].
// cninja has 2 buttons; slice [5:0] explicitly (the family JTFRAME_BUTTONS is 3
// for cbuster, so the macro would overflow this 8-bit-per-player word).
wire [15:0] port_a = { cab_1p[1], 1'b1, joystick2[5:0],
                       cab_1p[0], 1'b1, joystick1[5:0] };
wire [15:0] port_b = { 12'hfff, ~LVBL, service, coin[1:0] };
wire [15:0] port_c = dipsw;

// ---- table fetch (combinational: prot reads are not wait-stated, so dout
//      must be valid in the same cycle the CPU samples it) ----
jtframe_prom #(
    .DW    ( 36                            ),
    .AW    ( 10                            ),
    .SIMHEX( "jtcninja_deco104_table.hex"  ),
    .SYNHEX( "jtcninja_deco104_table.hex"  )
) u_tbl(
    .clk    ( clk    ),
    .cen    ( 1'b1   ),
    .data   ( 36'd0  ),
    .rd_addr( tidx   ),
    .wr_addr( 10'd0  ),
    .we     ( 1'b0   ),
    .q      ( tw     )
);

// tokens: [5p +: 5] = { blank, rot[1:0], sel[1:0] } for input nibble p
wire        e_port = tw[20];
wire [ 1:0] e_psel = tw[22:21];
wire [ 7:0] e_off  = tw[30:23];
wire        e_xor  = tw[31];
wire        e_nand = tw[32];

wire [15:0] e_src  = e_port ? (e_psel==2'd0 ? port_a :
                               e_psel==2'd1 ? port_b : port_c)
                            : ram_q;

// rambank in BRAM: port0 = CPU write at access start, port1 = protection read.
jtframe_dual_ram #(.DW(16), .AW(8)) u_rambank(
    .clk0   ( clk    ),
    .data0  ( din    ),
    .addr0  ( {curbank, ra_off[7:1]} ),
    .we0    ( acc_start & is_wr      ),
    .q0     (        ),
    .clk1   ( clk    ),
    .data1  ( 16'd0  ),
    .addr1  ( {curbank, e_off[7:1]}  ),
    .we1    ( 1'b0   ),
    .q1     ( ram_q  )
);

// reorder(): input nibble p -> output nibble sel[p], left-rotated by rot[p]
// (rot r: out[k]=in[(k-r)&3]); blank tokens drop the nibble. Equivalent to the
// old per-bit weights, just decoded from the native nibble form.
reg  [15:0] reordered;
integer     p;
reg  [ 1:0] t_sel, t_rot;
reg         t_blank;
reg  [ 3:0] innib, rotnib;
always @* begin
    reordered = 16'd0;
    for( p=0; p<4; p=p+1 ) begin
        t_sel   = tw[5*p   +: 2];
        t_rot   = tw[5*p+2 +: 2];
        t_blank = tw[5*p+4];
        innib   = e_src[4*p +: 4];
        case( t_rot )
            2'd0: rotnib = innib;
            2'd1: rotnib = { innib[2:0], innib[3]   };
            2'd2: rotnib = { innib[1:0], innib[3:2] };
            2'd3: rotnib = { innib[0],   innib[3:1] };
        endcase
        if( !t_blank ) reordered = reordered | ( {12'd0, rotnib} << (4*t_sel) );
    end
end

wire [15:0] post_xor  = e_xor  ? (reordered ^ m_xor)  : reordered;
wire [15:0] post_nand = e_nand ? (post_xor & ~m_nand) : post_xor;

// ---- access edge detection (apply read/write side effects once) ----
reg  cs_l;
wire acc_start = cs & ~cs_l;
wire is_wr     = ~rnw;
wire is_rd     =  rnw;
wire latch_hit = latchflag && (ra==latchaddr);

// latch read-back held for the whole access
reg        show_latch;
reg [15:0] latch_held;
reg        bw_check;        // pending bankswitch eval (tw valid the cycle after acc_start)
assign dout = show_latch ? latch_held : post_nand;

always @(posedge clk, posedge rst) begin
    if( rst ) begin
        curbank   <= 0;
        m_xor     <= 0;
        m_nand    <= 0;
        latchaddr <= 11'h7ff;
        latchdata <= 0;
        latchflag <= 0;
        show_latch<= 0;
        snd_latch <= 0;
        snd_irq   <= 0;
        cs_l      <= 0;
        bw_check  <= 0;
    end else begin
        cs_l     <= cs;
        snd_irq  <= 0;         // 1-clk pulse: re-triggers each soundlatch write
        bw_check <= 0;         // 1-clk pulse: evaluated the cycle after acc_start
        if( !cs ) show_latch <= 0;

        // bankswitch side effect, deferred one cycle so the registered tw
        // (e_port/e_off) matches the current access (MAME: off==0x66 on a
        // non-latch read toggles the rambank). The address is stable for the
        // whole access, so curbank still toggles once, before the next access.
        if( bw_check && !e_port && e_off==8'h66 ) curbank <= ~curbank;

        if( acc_start && is_wr ) begin
            // WRITE
            latchaddr <= ra;
            latchdata <= din;
            latchflag <= 1;
            // rambank write handled by u_rambank port0 (we0 = acc_start & is_wr)
            case( ra_off )
                8'h42: m_xor  <= din;
                8'hee: m_nand <= din;
                8'ha8: begin snd_latch <= din[7:0]; snd_irq <= 1; end
                default:;
            endcase
        end

        if( acc_start && is_rd ) begin
            // READ: decide latch read-back at access start, then clear flag.
            show_latch <= latch_hit;
            if( latch_hit ) latch_held <= latchdata;
            latchflag <= 0;
            // arm the bankswitch check for next cycle (tw not yet valid here)
            bw_check  <= ~latch_hit;
        end
    end
end

endmodule
