	ORG $8000

SCR_PALRAM	EQU $3800
CHR_PALRAM	EQU $38C0
HPOS_LOW	EQU $3B08
HPOS_HIGH	EQU $3B09
VPOS_LOW	EQU $3B0A
VPOS_HIGH	EQU $3B0B
OKOUT		EQU $3C00
BANK		EQU $3E00
FLIP		EQU $3D00
JOY1		EQU $3001
JOY2		EQU $3002
CRC			EQU $3005

CHR			EQU $2000
CHR_ATT		EQU $2400
SCR			EQU $2800
SCR_ATT		EQU $2C00

FLIPVAR		EQU $1010

RESET: 
	ORCC #$10
	LDS	#$1D00-1
	LDA #$18
	TFR A,DP
	CLRA
	STA	BANK
	LDA #0
	STA FLIP
	CLRA
	STA FLIPVAR
	CLRA
	STA HPOS_LOW
	STA HPOS_HIGH
	STA VPOS_LOW
	STA VPOS_HIGH
	CLR >0

	ANDCC #$EF
@L:
	LDA #1
	CMPA >0
	BGT @L

;	LDX #$2000
;	CLRA
;@L2:
;	STA ,x+
;	CMPX #$2400
;	BNE @L2

	LDA #$0
	LDX #$1E00
@L3:
	STA ,X+
	STA ,X+
	STA ,X+
	STA ,X+
	INCA
	CMPX #$2000
	BLT @L3

@L:
	LDA #3
	CMPA >0
	BNE @L

	LDA #100
	LDX #$1E00
@L3:
	STA ,X+
	STA ,X+
	STA ,X+
	STA ,X+
	INCA
	CMPX #$2000
	BLT @L3
	
	CLR OKOUT
	CLR OKOUT

FIN:
	BRA FIN

OBJDATA:
	FDB 1,1,100,10
	FDB 1,1,100,10

IRQSERVICE:
	INC >0
	LDA #2
	CMPA >0
	BEQ OBJRF
	;LDA #4
	;CMPA >0
	;BEQ OBJRF
	BRA IRQFIN
OBJRF:
	CLR OKOUT
IRQFIN:
	RTI

	FILL $FF,$FFF8-*

	ORG $FFF8
	.DW IRQSERVICE
	FILL $FF,$FFFE-*
	ORG $FFFE
	.DW	$8000	; Reset vector
